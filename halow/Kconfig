## halow/Kconfig
```kconfig
# Copyright 2025-2026 Morse Micro
# SPDX-License-Identifier: Apache-2.0

rsource "components/firmware/Kconfig"
rsource "components/mmpktmem/Kconfig"
rsource "components/shims/Kconfig"
rsource "components/regdb/Kconfig"

menu "Wi-Fi HaLow Connection Manager"

    config WIFI_HALOW
        bool "Enable Morse Micro Wi-Fi HaLow support"
        default y
        # Needed by the supplicant crypto glue (components/shims/crypto_mbedtls_mm.c): AES/CMAC
        # for the key hierarchy and BIP, ECP + ECDH on P-256 for SAE (WPA3) and OWE.
        select MBEDTLS_AES_C
        select MBEDTLS_CMAC_C
        select MBEDTLS_ECP_C
        select MBEDTLS_ECP_DP_SECP256R1_ENABLED
        select MBEDTLS_ECDH_C

    config HALOW_COUNTRY_CODE
        string "Country code to use for Wi-Fi HaLow"
        default "??"

	config HALOW_PS_MODE
		bool "Enable Morse Micro HaLow Powersave Mode"
		default true
		depends on MM_WAKE >= 0
		depends on MM_BUSY >= 0
		help
			This can only be set to true for devices which have the BUSY and WAKE
			pins connected.

    config HALOW_AP_MODE
        bool "Enable HaLow AP-mode support"
        default n
        help
            Adds requisite components for AP-mode viathe HaLow interface. This
            is disabled by default due to the extra functionality increasing the
            flash and ram requirements by a non inconsequential amount.

    config HALOW_RELAY_MODE
        bool "Enable HaLow S1G relay mode support"
        default n
        depends on HALOW_AP_MODE
        help
            Builds morselib with S1G Relay support (ENABLE_MMWLAN_RELAY) so that
            mmhalow_relay_enable() can bring the device up as the root AP, a
            repeater (relay STA + relay AP) or a relay STA of an S1G relay network.
            Requires AP mode.

            ALPHA NOTICE: the S1G Relay API is an alpha API that is under
            development. It is not intended for production use. It may be removed
            in a future release and/or breaking changes may be introduced.

endmenu
```

## halow/components/mmpktmem/Kconfig
```kconfig
# Copyright 2024 Morse Micro
# SPDX-License-Identifier: Apache-2.0

menu "Morse Micro Packet Memory Configuration"
    config MMPKTMEM_TX_POOL_N_BLOCKS
        int "TX queue blocks"
        default 32
        help
            Number of blocks allocated for the transmit queue

    config MMPKTMEM_RX_POOL_N_BLOCKS
        int "RX queue blocks"
        default 32
        help
            Number of blocks allocated for the receive queue

    config MMPKTMEM_TX_MGMT_POOL_N_BLOCKS
        int "TX management frame reserved blocks"
        default 4 if HALOW_RELAY_MODE
        default 0
        help
            Number of transmit blocks reserved for management frames, so that beacons
            and frames to associating stations can still be allocated when the data
            pool is exhausted. 0 disables the reserved pool. The SDK's relay_mode
            application uses 4.
endmenu
```

## halow/components/shims/Kconfig
```kconfig
# Copyright 2024-2026 Morse Micro
# SPDX-License-Identifier: Apache-2.0
menu "Morse Micro Shim Configuration"
    config MM_RESET_N
        int "RESET_N pin for MM chip"
        default -1
        help
            Output gpio pin used to control the RESET_N line.

    config MM_RESET_SETTLE_MS
        int "Delay after releasing RESET_N, in milliseconds"
        default 20
        range 1 1000
        help
            Delay between releasing RESET_N and the first SPI clocking. This must cover the
            transceiver's boot, not just its reset pulse.

            The startup handshake clocks a training sequence and then polls for the command
            response. A transceiver that is still booting when that clocking starts can latch
            onto a bit phase that is not byte aligned with the host's framing and hold it for
            the rest of the boot, so the handshake reads a correct response at the wrong
            alignment and the driver rejects it as an invalid ack. The failure is intermittent
            and looks like absent or faulty hardware.

            Adjust this based on the boot time measured on your particular board to ensure
            that the transceiver has sufficient time to boot.

    config MM_WAKE
        int "WAKE pin for MM chip"
        default -1
        help
            Output gpio pin used to control the WAKE line.

    config MM_BUSY
        int "BUSY pin for the MM chip"
        default -1
        help
            Input pin used as a rising edge interrupt.

    config MM_SPI_SCK
        int "SCK pin for MM chip"
        default -1
        help
            SPI clock pin.

    config MM_SPI_MOSI
        int "MOSI pin for MM chip"
        default -1
        help
            SPI master out slave in pin.

    config MM_SPI_MISO
        int "MISO pin for MM chip"
        default -1
        help
            SPI master in slave out pin.

    config MM_SPI_CS
        int "SPI CS pin for MM chip"
        default -1
        help
            SPI chip select pin.

    config MM_SPI_IRQ
        int "SPI IRQ pin for MM chip"
        default -1
        help
            Out of band interupt pin used to indicate that
            the MM chip has data for the host.

    config MM_SPI_CLOCK_MHZ
        int "SPI clock for MM chip (MHz)"
        range 1 50
        default 40
        help
            Requested SPI clock. The MM chip allows up to 50 MHz, but the ESP SPI clock is
            divided from an 80 MHz source, so 40 MHz is the highest exact value; the driver
            rounds other values to the nearest frequency it can produce.

    config MM_SPI_FAST_PATH
        bool "Drive the SPI peripheral directly for MM chip transfers"
        default y
        help
            The SDIO-over-SPI protocol makes many single-byte transfers per packet (bus ready
            polls, tokens, CRC bytes). Through the ESP-IDF SPI master driver each of them is a
            complete driver transaction (bus lock, DMA set-up, start, wait), which is much
            longer than the byte itself and limits throughput.

            With this option the driver only configures the bus and device once; every
            transfer then writes the SPI data registers directly (CPU mode, up to 64 bytes per
            hardware transfer, longer buffers in 64-byte chunks) and polls for completion, as
            the mm-iot-sdk STM32 platforms do. Chip select is a GPIO driven by morselib, so the
            chunking is not visible to the MM chip. Disable to use the SPI master driver for
            every transfer.

endmenu
```

## halow/examples/relay_root/main/Kconfig.projbuild
```kconfig
# Copyright 2026 siraisisatoru
#
# SPDX-License-Identifier: Apache-2.0

menu "HaLow relay_root Example Configuration"

config WIFI_SSID
	string "Wi-Fi SSID"
	default "MorseMicro"
	help
		SSID of the relay network. Repeaters advertise the SSID their relay STA connected to,
		so every node of the network uses this value. The default matches the mm-iot-sdk
		relay_mode application.

config WIFI_PSK
	string "Wi-Fi Password"
	default "12345678"
	help
		SAE passphrase of the relay network. Leave empty for an open network.

config S1G_CHANNEL
    int "S1G Channel"
    default 38 if HALOW_COUNTRY_CODE = "AU" && WIFI_MORSE_AU_CHANNELISATION_2020
    default 37 if HALOW_COUNTRY_CODE = "AU"
    default 44
    help
        S1G channel number for the root AP. Together with S1G_OPCLASS this must match an entry
        in the regulatory database for HALOW_COUNTRY_CODE. Repeaters follow the channel of
        the AP they connect to. The defaults select a 2 MHz channel at 921 MHz (2020) or
        920.5 MHz (2024/REVMF) for AU, otherwise the SDK's 8 MHz US channel.

config S1G_OPCLASS
    int "S1G Op-Class"
    default 69 if HALOW_COUNTRY_CODE = "AU" && WIFI_MORSE_AU_CHANNELISATION_2020
    default 51 if HALOW_COUNTRY_CODE = "AU"
    default 71
    help
        Global operating class matching S1G_CHANNEL.

config RELAY_ROOT_MAX_STAS
    int "Maximum directly associated stations"
    range 1 20
    default 4
    help
        Maximum number of stations (repeaters or plain stations) that can associate with the
        root AP directly. Nodes behind a repeater do not count against this limit.

config RELAY_ROOT_FORWARDING_TABLE_SIZE
    int "Relay forwarding table size"
    range 0 1024
    default 0
    help
        Number of entries in the relay forwarding table. It needs one entry per node that
        is reachable through a repeater. 0 selects the SDK default (64).

config RELAY_ROOT_IP_ADDR
    string "Root static IPv4 address"
    default "192.168.12.1"
    help
        The root has no DHCP server, so it uses this static address and other nodes need
        static addresses in the same subnet.

config RELAY_ROOT_NETMASK
    string "Root IPv4 netmask"
    default "255.255.255.0"

config RELAY_ROOT_UDP_ECHO_PORT
    int "UDP echo port"
    range 0 65535
    default 12345
    help
        UDP port on which the root echoes datagrams back to the sender, for end-to-end tests
        through the relay network. 0 disables the echo server.

endmenu
```

## halow/examples/softap/main/Kconfig.projbuild
```kconfig
# Copyright 2026 Morse Micro
#
# SPDX-License-Identifier: Apache-2.0

menu "HaLow softap Example Configuration"

config WIFI_SSID
	string "Wi-Fi SSID"
	default "MorseMicroESP32AP"

config WIFI_PSK
	string "Wi-Fi Password"
	default "12345678"

config S1G_CHANNEL
    int "S1G Channel"
    default 38 if HALOW_COUNTRY_CODE = "AU" && WIFI_MORSE_AU_CHANNELISATION_2020
    default 37 if HALOW_COUNTRY_CODE = "AU"
    default 44
    help
        S1G channel number for the AP. Together with S1G_OPCLASS this must match an entry in the
        regulatory database for HALOW_COUNTRY_CODE. The defaults select a 2 MHz channel at
        921 MHz (2020) or 920.5 MHz (2024/REVMF) for AU, otherwise the SDK's 8 MHz US channel.

config S1G_OPCLASS
    int "S1G Op-Class"
    default 69 if HALOW_COUNTRY_CODE = "AU" && WIFI_MORSE_AU_CHANNELISATION_2020
    default 51 if HALOW_COUNTRY_CODE = "AU"
    default 71
    help
        Global operating class matching S1G_CHANNEL.

endmenu
```
